## configs/qemu_riscv32_virt_optee_defconfig
```kconfig
BR2_riscv=y
BR2_RISCV_32=y
BR2_RISCV_ISA_RVC=y
BR2_PACKAGE_HOST_LINUX_HEADERS_CUSTOM_6_12=y
BR2_TOOLCHAIN_BUILDROOT_CXX=y
BR2_SYSTEM_DHCP="eth0"
BR2_ROOTFS_OVERLAY="board/qemu/riscv32-virt-optee/rootfs_overlay"
BR2_ROOTFS_POST_BUILD_SCRIPT="board/qemu/post-image.sh"
BR2_ROOTFS_POST_IMAGE_SCRIPT="support/scripts/genimage.sh"
BR2_ROOTFS_POST_BUILD_SCRIPT_ARGS="$(BR2_DEFCONFIG)"
BR2_ROOTFS_POST_IMAGE_SCRIPT_ARGS="-c board/qemu/riscv32-virt-optee/genimage_sdcard.cfg"
BR2_LINUX_KERNEL=y
BR2_LINUX_KERNEL_CUSTOM_TARBALL=y
BR2_LINUX_KERNEL_CUSTOM_TARBALL_LOCATION="https://gitlab.com/riseproject/riscv-optee/linux/-/archive/9007f552b318522b0b36c78b838f70d9dd604d80/linux-dev-optee-mpxy-v9.tar.gz"
BR2_LINUX_KERNEL_USE_ARCH_DEFAULT_CONFIG=y
BR2_LINUX_KERNEL_CONFIG_FRAGMENT_FILES="board/qemu/riscv32-virt-optee/linux.fragment"
BR2_GLOBAL_PATCH_DIR="board/qemu/riscv32-virt-optee/patches"
BR2_LINUX_KERNEL_PATCH="board/qemu/riscv32-virt-optee/linux-patches"
BR2_LINUX_KERNEL_DTS_SUPPORT=y
BR2_LINUX_KERNEL_INTREE_DTS_NAME="qemu/qemu_rv32_virt_domain"
BR2_LINUX_KERNEL_INSTALL_TARGET=y
BR2_PACKAGE_OPTEE_CLIENT=y
BR2_PACKAGE_OPTEE_EXAMPLES=y
BR2_PACKAGE_OPTEE_TEST=y
BR2_TARGET_ROOTFS_EXT2=y
BR2_TARGET_ROOTFS_EXT2_SIZE="160M"
BR2_TARGET_OPTEE_OS=y
BR2_TARGET_OPTEE_OS_CUSTOM_GIT=y
BR2_TARGET_OPTEE_OS_CUSTOM_REPO_URL="https://github.com/laukik-hase/optee_os.git"
BR2_TARGET_OPTEE_OS_CUSTOM_REPO_VERSION="feat/rv32_optee_qemu"
BR2_TARGET_OPTEE_OS_NEEDS_PYTHON_CRYPTOGRAPHY=y
BR2_TARGET_OPTEE_OS_PLATFORM="virt"
BR2_TARGET_OPTEE_OS_PLATFORM_FLAVOR="rv32"
BR2_TARGET_OPTEE_OS_ADDITIONAL_VARIABLES="ARCH=riscv DEBUG=1 CFG_TEE_CORE_NB_CORE=2 CFG_NUM_THREADS=2 CFG_TEE_CORE_LOG_LEVEL=2 CFG_TEE_TA_LOG_LEVEL=2 CFG_UNWIND=y CFG_IN_TREE_EARLY_TAS=trusted_keys/f04a0fe7-1f5d-4b9b-abf7-619b85b4ce8c CFG_TEE_CORE_DEBUG=y CFG_16550_UART=y CFG_RISCV_PLIC=n CFG_TDDRAM_START=0xF1000000 CFG_TDDRAM_SIZE=0x01000000"
BR2_TARGET_OPTEE_OS_CORE_IMAGES="tee.bin"
BR2_TARGET_OPENSBI=y
BR2_TARGET_OPENSBI_CUSTOM_TARBALL=y
BR2_TARGET_OPENSBI_CUSTOM_TARBALL_LOCATION="https://gitlab.com/riseproject/riscv-optee/opensbi/-/archive/a1cdb6f4c7f511e3d0d41fc89495aefbd559e0b7/opensbi-dev-optee-mpxy-v9.tar.gz"
BR2_TARGET_OPENSBI_PLAT="generic"
BR2_TARGET_UBOOT=y
BR2_TARGET_UBOOT_BUILD_SYSTEM_KCONFIG=y
BR2_TARGET_UBOOT_CUSTOM_TARBALL=y
BR2_TARGET_UBOOT_CUSTOM_TARBALL_LOCATION="https://gitlab.com/riseproject/riscv-optee/u-boot/-/archive/32bdb252fab83028768a269fb304b9356547ccbd/u-boot-dev-optee-mpxy-v5.tar.gz"
BR2_TARGET_UBOOT_BOARD_DEFCONFIG="qemu-riscv32_spl"
BR2_TARGET_UBOOT_CONFIG_FRAGMENT_FILES="board/qemu/riscv32-virt-optee/uboot.fragment"
BR2_TARGET_UBOOT_NEEDS_GNUTLS=y
BR2_TARGET_UBOOT_NEEDS_PYLIBFDT=y
BR2_TARGET_UBOOT_NEEDS_OPTEE_TEE=y
BR2_TARGET_UBOOT_NEEDS_OPTEE_TEE_BIN=y
BR2_TARGET_UBOOT_NEEDS_OPENSBI=y
BR2_TARGET_UBOOT_FORMAT_CUSTOM=y
BR2_TARGET_UBOOT_FORMAT_CUSTOM_NAME="u-boot.itb"
BR2_TARGET_UBOOT_SPL=y
BR2_TARGET_UBOOT_SPL_NAME="spl/u-boot-spl"
BR2_PACKAGE_HOST_GENIMAGE=y
BR2_PACKAGE_HOST_QEMU=y
BR2_PACKAGE_HOST_QEMU_SYSTEM_MODE=y
```
